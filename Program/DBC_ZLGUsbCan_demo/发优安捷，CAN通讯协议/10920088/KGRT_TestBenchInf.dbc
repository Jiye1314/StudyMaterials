VERSION "HIPBNYYYYYYYYYYYYYYYYYYYYYYYYYYYNNNNNNNNNN/4/%%%/4/'%**4NNN///"

NS_ :

BS_:

BU_: CPU_H

BO_ 1922 TestBench_speedReq: 8 Vector__XXX
 SG_ fixData : 0|24@1+ (1,0) [5323524|5323524] ""  CPU_H
 SG_ speedReq : 24|16@1+ (1,0) [0|10000] "rpm"  CPU_H

BA_DEF_ BU_  "NmStationAddress" INT 0 200;
BA_DEF_  "BusType" STRING ;
BA_DEF_  "Manufacturer" ENUM  "invalid","invalid","invalid","invalid","invalid","invalid","LINDE","invalid";
BA_DEF_  "NWM-Typ" ENUM  "invalid","invalid","invalid","invalid","invalid","invalid","invalid","invalid","invalid","invalid","LINDENM";
BA_DEF_DEF_  "NmStationAddress" 0;
BA_DEF_DEF_  "BusType" "";
BA_DEF_DEF_  "Manufacturer" "LINDE";
BA_DEF_DEF_  "NWM-Typ" "LINDENM";
BA_ "BusType" "CAN";
BA_ "NmStationAddress" BU_ CPU_H 2;
